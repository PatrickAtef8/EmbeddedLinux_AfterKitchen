## 01-Yocto/meta-Qt6-custom/conf/layer.conf
```bitbake
# We have a conf and classes directory, add to BBPATH
BBPATH .= ":${LAYERDIR}"

# We have recipes-* directories, add to BBFILES
BBFILES += "${LAYERDIR}/recipes-*/*/*.bb \
            ${LAYERDIR}/recipes-*/*/*.bbappend"

BBFILE_COLLECTIONS += "meta-Qt6-custom"
BBFILE_PATTERN_meta-Qt6-custom = "^${LAYERDIR}/"
BBFILE_PRIORITY_meta-Qt6-custom = "6"

LAYERDEPENDS_meta-Qt6-custom = "core qt6-layer openembedded-layer meta-python raspberrypi"
LAYERSERIES_COMPAT_meta-Qt6-custom = "kirkstone"
```
